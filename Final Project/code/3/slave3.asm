DATA SEGMENT
 PORTA EQU 00H
 PORTB EQU 02H
 PORTC EQU 04H
 PORT_CON EQU 06H
DATA ENDS
CODE SEGMENT
 MOV AX,DATA
 MOV DS, AX

ORG 0000H
START:

 MOV DX, PORT_CON
 MOV AL, 10000010B; port C (output), port A (output) in mode 0 and PORT B (INPUT) in mode 0
 OUT DX, AL

 MOV AL, 11000000B
 MOV DX, PORTC
 OUT DX,AL
 JMP _LOOP
_LOOP:
 MOV DX, PORTB
 IN AL, DX
 CMP AL, 11111110B;if btn pb0 pressed then go to state0
 JZ STATE0
 IN AL, DX
 CMP AL, 11111101B;if btn pb1 pressed then go to state1
 JZ STATE1
 IN AL, DX
 CMP AL, 11111011B;if btn pb2 pressed then go to state2
 JZ STATE2
 IN AL, DX
 CMP AL, 11110111B;if btn pb3 pressed then go to state3
 JZ STATE3
 JMP _LOOP ;IF NO BTN PRESSED


STATE0:
 MOV AL, 10000001B
 MOV DX, PORTC
 OUT DX,AL
 JMP _LOOP
STATE1:
 MOV AL, 10000010B
 MOV DX, PORTC
 OUT DX,AL
 JMP _LOOP
STATE2:
 MOV AL, 10000100B
 MOV DX, PORTC
 OUT DX,AL
 JMP _LOOP
STATE3:
 MOV AL, 10001000B
 MOV DX, PORTC
 OUT DX,AL
 JMP _LOOP

JMP START
CODE ENDS
END